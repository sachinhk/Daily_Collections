#include "main.h"
#include "stm32f10x.h"
//#include "stm32_eval.h"
#include "stm32f10x_flash.h"
#include "stm32f10x_rcc.h"

#include <stdio.h>
#include <string.h>
#include <stdlib.h>

#include "kmy_LowPowerDrv.h"
#include "kmy_LCDDrv.h"
#include "MenuOperate.h"
#include "lcd.h"
#include "key.h"
#include "SelfTest.h"
#include "kmy_BeepDrv.h"
#include "kmy_Time.h"
#include "kmy_FlashDrv.h"
#include "kmy_EEPROMDrv.h"
#include "kmy_MagcardDrv.h"
#include "kmy_USART1Drv.h"
//#include "kmy_USART2Drv.h"
#include "kmy_USART3Drv.h"
#include "kmy_PrinterDrv.h"
#include "kmy_TamperDrv.h"
#include "kmy_Misc.h"
#include "kmy_BattaryDrv.h"
#include "kmy_psamDrv.h"
#include "kmy_Adc.h"
#include "kmy_Rfdrv.h"
#include "Transaction.h"  
#include "PhoneBook.h"
#include "gprs.h"
#include "SelfTest.h"
#include "global_variable.h"
#include "setting.h"
#include "Tool.h"
#include "CallRecord.h"
#include "EepromFileSystem.h"
#include "mypure_library.h"
#include "message.h"
#include "kmy_GprsDrv.h"
#include "kmy_wifi.h"
#include "kmy_WiFi_USARTDrv.h"

#pragma pack(4)

uint8_t SW_Status=0;
uint8_t FirstPowerOn = 1;
uint8_t Cntflag = 0;
static char GetSignalflag=1; 


const unsigned char templogo2[]={
	/*------------------------------------------------------------------------------
	;  若数据乱码，请检查字模格式设置，注意选择正确的取模方向和字节位顺序。
	;  源文件 / 文字 : C:\Documents and Settings\Administrator\My Documents\My Pictures\temp.bmp字模
	;  宽×高（像素）: 128×64
	;  字模格式/大小 : 单色点阵液晶字模，纵向取模，字节倒序/1024字节
	;  数据转换日期  : 2011-10-10 17:39:19
	------------------------------------------------------------------------------*/
	0x00,0x00,0x00,0x00,0x00,0x00,0x00,0x00,0x00,0x00,0xF8,0xF8,0xF8,0x00,0x00,0x00,
	0x00,0x00,0x00,0x80,0x80,0x80,0x80,0x80,0x00,0x00,0x00,0x00,0x80,0x80,0xE0,0xF0,
	0xF8,0x80,0x80,0x00,0x00,0x00,0x80,0x80,0x80,0x00,0x80,0x80,0x80,0x80,0x80,0x00,
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	0x00,0x00,0x00,0x00,0x00,0x00,0x00,0x00,0x00,0x00,0x00,0x00,0x00,0x00,0x00,0x00,
};


#if 0
const unsigned char PoweronLogo[]=
{
	/*------------------------------------------------------------------------------
	;  若数据乱码，请检查字模格式设置，注意选择正确的取模方向和字节位顺序。
	;  源文件 / 文字 : D:\公司资料\KMY\印尼\印尼LOGO.bmp字模
	;  宽×高（像素）: 128×64
	;  字模格式/大小 : 单色点阵液晶字模，纵向取模，字节倒序/1024字节
	;  数据转换日期  : 2011-10-13 13:42:39
	------------------------------------------------------------------------------*/
	0x00,0x00,0x00,0x00,0x00,0x00,0x00,0x00,0x00,0x00,0x00,0x00,0x00,0x00,0x00,0x00,
	0x00,0x00,0x00,0x00,0x00,0x00,0x00,0x00,0x00,0x00,0x80,0x80,0x80,0xC0,0xC0,0xC0,
	0xC0,0xE0,0xE0,0xE0,0xE0,0xF0,0xF0,0x78,0x00,0x00,0x00,0x00,0x00,0x00,0x00,0x00,
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	0x00,0x00,0x00,0x00,0x00,0x00,0x00,0x00,0x00,0x00,0x00,0x00,0x00,0x00,0x00,0x00,
};
#else
#if 1	//反显KMY
const unsigned char PoweronLogo[]=
{
	/*------------------------------------------------------------------------------
	;  若数据乱码，请检查字模格式设置，注意选择正确的取模方向和字节位顺序。
	;  源文件 / 文字 : D:\公司资料\KMY801H\document\KMY-128x64.bmp字模
	;  宽×高（像素）: 128×64
	;  字模格式/大小 : 单色点阵液晶字模，纵向取模，字节倒序/1024字节
	;  数据转换日期  : 2011-12-2 9:57:27
	------------------------------------------------------------------------------*/
	0xFF,0xFF,0xFF,0xFF,0xFF,0xFF,0xFF,0xFF,0xFF,0xFF,0xFF,0xFF,0xFF,0xFF,0xFF,0xFF,
	0xFF,0xFF,0xFF,0xFF,0xFF,0xFF,0xFF,0xFF,0xFF,0xFF,0xFF,0xFF,0xFF,0xFF,0xFF,0xFF,
	0xFF,0xFF,0x07,0x07,0x07,0x07,0x07,0xFF,0xFF,0x7F,0x3F,0x1F,0x07,0x07,0x07,0x87,
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	0xFD,0xFC,0xFD,0xFD,0xFF,0xFF,0xFF,0xFF,0xFF,0xFF,0xFF,0xFF,0xFF,0xFF,0xFF,0xFF,
};

#else	//不反显KMY
const unsigned char PoweronLogo[]=
{
	/*------------------------------------------------------------------------------
	;  若数据乱码，请检查字模格式设置，注意选择正确的取模方向和字节位顺序。
	;  源文件 / 文字 : D:\公司资料\KMY801H\document\KMY-128x64.bmp字模
	;  宽×高（像素）: 128×64
	;  字模格式/大小 : 单色点阵液晶字模，纵向取模，字节倒序/1024字节
	;  数据转换日期  : 2011-12-2 9:53:49
	------------------------------------------------------------------------------*/
	0x00,0x00,0x00,0x00,0x00,0x00,0x00,0x00,0x00,0x00,0x00,0x00,0x00,0x00,0x00,0x00,
	0x00,0x00,0x00,0x00,0x00,0x00,0x00,0x00,0x00,0x00,0x00,0x00,0x00,0x00,0x00,0x00,
	0x00,0x00,0xF8,0xF8,0xF8,0xF8,0xF8,0x00,0x00,0x80,0xC0,0xE0,0xF8,0xF8,0xF8,0x78,
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	0x02,0x03,0x02,0x02,0x00,0x00,0x00,0x00,0x00,0x00,0x00,0x00,0x00,0x00,0x00,0x00,
};
#endif
#endif



const unsigned char kmylogo[]={
	/*------------------------------------------------------------------------------
	;  若数据乱码，请检查字模格式设置，注意选择正确的取模方向和字节位顺序。
	;  源文件 / 文字 : D:\文档\logo.bmp字模
	;  宽×高（像素）: 52×18
	;  字模格式/大小 : 单色点阵液晶字模，纵向取模，字节正序/156字节
	;  数据转换日期  : 2010-5-24 下午 05:01:35
	------------------------------------------------------------------------------*/
	0xFF,0xCA,0xCA,0xCA,0xEA,0xFE,0xFE,0xFA,0xFA,0xEA,0xCB,0xCF,0xCF,0xDF,0xFF,0xFF,
	0xFF,0xFF,0xCA,0xCA,0xCA,0xCB,0xCA,0xFA,0xFE,0xFF,0xFF,0xFA,0xCA,0xCB,0xCA,0xCA,
	0xCA,0xFF,0xFF,0xFF,0xFF,0xCF,0xCF,0xCB,0xCA,0xFA,0xFE,0xFE,0xFE,0xFA,0xEA,0xCB,
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	0xC0,0xC0,0xC0,0xC0,0xC0,0xC0,0xC0,0xC0,0xC0,0xC0,0xC0,0xC0,
};


const unsigned char templogo3[]=
{
	/*------------------------------------------------------------------------------
	;  若数据乱码，请检查字模格式设置，注意选择正确的取模方向和字节位顺序。
	;  源文件 / 文字 : 字模
	;  宽×高（像素）: 60×5
	;  字模格式/大小 : 单色点阵液晶字模，纵向取模，字节倒序/60字节
	;  数据转换日期  : 2011-10-13 9:33:03
	------------------------------------------------------------------------------*/
	0x1F,0x1F,0x1F,0x1F,0x1F,0x1F,0x1F,0x1F,0x1F,0x1F,0x1F,0x1F,0x1F,0x1F,0x1F,0x1F,
	0x1F,0x1F,0x1F,0x1F,0x1F,0x1F,0x1F,0x1F,0x1F,0x1F,0x1F,0x1F,0x1F,0x1F,0x1F,0x1F,
	0x1F,0x1F,0x1F,0x1F,0x1F,0x1F,0x1F,0x1F,0x1F,0x1F,0x1F,0x1F,0x1F,0x1F,0x1F,0x1F,
	0x1F,0x1F,0x1F,0x1F,0x1F,0x1F,0x1F,0x1F,0x1F,0x1F,0x1F,0x1F,
};



//note:the library will call this function every 1ms
//this function can not be removed
void kmy_OneMiliSecondCallThread(void)
{
}

char MainMenuScreen(char *msg)
{
	static struct MenuFuc_Language2 Menu[5]={		
		//{"1.交易","1.Transaction",Transaction},
		//{"1.交易","1.Transaction",PhoneSearch},
		{"1.交易","1.Download File",Download_File},
		{"2.电话记录","2.CallRecords",MainMenuScreen_Calls},
		{"3.终端设置","3.Settings",MainMenuScreen_Settings},
		{"4.应用工具","4.Toolbox",MainMenuScreen_ToolBox},
		{"5.硬件自测","5.SelfTest",SelfTest},
	};
	struct MenuOperate_Language2 MenuOp={Menu,5,0,0,0,MaxRowOneScr,1,0,0};

	while(1)
	{
		MenuHandler_Language2(&MenuOp);
		if(MenuOp.RetVal==KEY_Enter)
		{
			MenuOp.FucRetVal=MenuOp.Menu->MenuFuc(msg);
			if(MenuOp.FucRetVal==KEY_WaitTimeout||MenuOp.FucRetVal==KEY_ReturnInitInterface)
			{
				CurProc=CurProc_Return;
				return MenuOp.FucRetVal;
			}
			else
			{
				clear_lcd();
				MenuOp.flashflag=1;
			}
		}
		else
		{
			CurProc=CurProc_Return;
			return MenuOp.RetVal;
		}
	}
}


static char ProcStandbyKey(char *msg);
static char Printlogo(char *msg);
extern char SelfTest_Soft(char*);
static void StandbyResponseUserMenu(unsigned char keyval)
{
	switch(keyval)
	{
		case KEY0:
			
		break;

		case KEY1:	

		break;

		case KEY2:		
		break;
		
		case KEY3:		
		break;
		
		case KEY4:		
		break;
		
		case KEY5:		
		break;
		
		case KEY6:		
		break;
		
		case KEY7:		
		break;
		
		case KEY8:		
		
		break;
		
		case KEY9:	
		
		break;

		case KEYJING:	
		CurProc=SelfTest;
		//CurProc_Return=ProcStandbyKey;
			CurProc_Return=Printlogo;
		InitFlag = 1;
		ShortcutKeyEnterFlag=1;
		break;

		case KEYXING:		
			
		break;

		case KEY_Enter:	
		//CurProc = MainMenuScreen;
		//CurProc_Return=ProcStandbyKey;
		CurProc_Return=Printlogo;
		InitFlag = 1;
		ShortcutKeyEnterFlag=1;
		break;

		case KEY_R2:	
		
		break;

		case KEY_R3:	
		break;

		case KEY_R4:	
		break;

		default:
		break;
	}
}


static void DisplayHourMinuteSecond(unsigned long second)
{
	unsigned long temp;
	unsigned char buff[4];

	temp=second%(24*60*60);
	temp=temp/(60*60);
	sprintf((char *)buff,"%02d:",temp);
	text_out(8,18,buff);

	temp=second%(60*60);
	temp=temp/60;
	sprintf((char *)buff,"%02d:",temp);
	text_out(3*6+8,18,buff);

	temp=second%60;
	sprintf((char *)buff,"%02d",temp);
	text_out(6*6+8,18,buff);
}


static void DisplayYearMothDayWeek(unsigned long second)
{
	unsigned char Buf[20];
	/*const unsigned char NumData[7][5]={		//宽×高（像素）: 4×5
	{0xF8,0xA8,0xF8,0x00},	//  0
	{0x00,0xF8,0x00,0x00},	//  1
	{0xB8,0xA8,0xE8,0x00},	//  2
	{0xA8,0xA8,0xF8,0x00},  		//  3
	{0xE0,0x20,0xF8,0x00},  		//  4
	{0xE8,0xA8,0xB8,0x00},  		//  5
	{0xF8,0xA8,0xB8,0x00}   		//  6
	};*/
	const unsigned char NumData[7][5]={		//宽×高（像素）: 4×5
		{0x1F,0x15,0x1F,0x00},	//  0
		{0x00,0x00,0x1F,0x00},	//  1
		{0x1D,0x15,0x17,0x00},	//  2
		{0x15,0x15,0x1F,0x00},  		//  3
		{0x07,0x04,0x1F,0x00},  		//  4
		{0x17,0x15,0x1D,0x00},  		//  5
		{0x1F,0x15,0x1D,0x00}   		//  6
	};

	unsigned int year;
	unsigned char mon;
	unsigned char day;
	unsigned char weekday;

	memset(Buf,0,sizeof(Buf));		
	kmy_TimeGetTime(&year,&mon,&day,NULL,NULL,NULL,&weekday);
	sprintf((char *)Buf,"%04d-%02d-%02d",year,mon,day);
	text_out(0,34,Buf);
	draw_pic(NumData[weekday],61,35,4,5);
}

const unsigned char CSPNs[5][15]={"正在搜索网络","中国移动","中国联通","中国电信","其它网络"};

static const unsigned char* GetNetName(unsigned char *netname)
{
	if(strstr((const char *)netname,"CHINA MOBILE")!=NULL)
	{			
		return CSPNs[1];
	}
	else if(strstr((const char *)netname,"UNICOM")!=NULL)
	{	
		return CSPNs[2];
	}
	else if(strstr((const char *)netname,"CHINA TELECOM")!=NULL)
	{	
		return CSPNs[3];
	}
	else if(strstr((const char *)netname,"\"")!=NULL)
	{		
		return CSPNs[4];
	}
	else
	{
		return CSPNs[0];
	}
}



const unsigned char pstr[5][24]={
	//{0x00,0x00,0x7F,0x40,0xC0,0xC0,0xC0,0xC0,0xC0,0x40,0x7F,0x00,0x00,0x00,0xF0,0x10,0x10,0x10,0x10,0x10,0x10,0x10,0xF0,0x00},
	//{0x00,0x00,0x7F,0x40,0xC0,0xC0,0xC0,0xC0,0xC0,0x40,0x7F,0x00,0x00,0x00,0xF0,0x10,0x50,0x50,0x50,0x50,0x50,0x10,0xF0,0x00},
	//{0x00,0x00,0x7F,0x40,0xC1,0xC1,0xC1,0xC1,0xC1,0x40,0x7F,0x00,0x00,0x00,0xF0,0x10,0x50,0x50,0x50,0x50,0x50,0x10,0xF0,0x00},
	//{0x00,0x00,0x7F,0x40,0xC5,0xC5,0xC5,0xC5,0xC5,0x40,0x7F,0x00,0x00,0x00,0xF0,0x10,0x50,0x50,0x50,0x50,0x50,0x10,0xF0,0x00},
	//{0x00,0x00,0x7F,0x40,0xD5,0xD5,0xD5,0xD5,0xD5,0x40,0x7F,0x00,0x00,0x00,0xF0,0x10,0x50,0x50,0x50,0x50,0x50,0x10,0xF0,0x00}

	
	{0xF0,0xFC,0x04,0x04,0x04,0x04,0x04,0x04,0x04,0x04,0x04,0xFC,0x00,0x03,0x02,0x02,0x02,0x02,0x02,0x02,0x02,0x02,0x02,0x03},
	{0xF0,0xFC,0x04,0x04,0x04,0x04,0x04,0x04,0x04,0xF4,0x04,0xFC,0x00,0x03,0x02,0x02,0x02,0x02,0x02,0x02,0x02,0x02,0x02,0x03},
	{0xF0,0xFC,0x04,0x04,0x04,0x04,0x04,0xF4,0x04,0xF4,0x04,0xFC,0x00,0x03,0x02,0x02,0x02,0x02,0x02,0x02,0x02,0x02,0x02,0x03},
	{0xF0,0xFC,0x04,0x04,0x04,0xF4,0x04,0xF4,0x04,0xF4,0x04,0xFC,0x00,0x03,0x02,0x02,0x02,0x02,0x02,0x02,0x02,0x02,0x02,0x03},
	{0xF0,0xFC,0x04,0xF4,0x04,0xF4,0x04,0xF4,0x04,0xF4,0x04,0xFC,0x00,0x03,0x02,0x02,0x02,0x02,0x02,0x02,0x02,0x02,0x02,0x03}
};

static void DisplayElectricity(int temp)
{
	if(temp<6500)temp=0;
	else if(temp>=6500&&temp<7000)temp=1;
	else if(temp>=7000&&temp<7500)temp=2;
	else if(temp>=7500&&temp<8000)temp=3;
	else temp=4;

	draw_pic(pstr[temp],116,0,12,12);
}


static void DisplayPleaseCharge(void)
{
	static char timecnt;

	timecnt++;
	if(timecnt>55/5)
	{
		timecnt=0;
		clear_lcd();
		DrawTitle_to_row_Language2(2,"电量不足，请充电","Please Charge");

		while(kmy_BatGetACStatus()==AcStatus_UnPlug);
		InitFlag=1;
	}
}

static void DisplaySignalQuality(int temp)
{
	const unsigned char pstr[6][24]={
		//{0x30,0x28,0x3E,0x28,0x30,0x00,0x00,0x00,0x00,0x00,0x00,0x00,0x00,0x00,0x00,0x00,0x00,0x00,0x00,0x00,0x00,0x00,0x00,0x00},
		//{0x30,0x28,0x3E,0x28,0x30,0x00,0x00,0x00,0x00,0x00,0x00,0x00,0x00,0x10,0x00,0x00,0x00,0x00,0x00,0x00,0x00,0x00,0x00,0x00},
		//{0x30,0x28,0x3E,0x28,0x30,0x00,0x00,0x00,0x00,0x00,0x00,0x00,0x00,0x10,0x00,0x70,0x00,0x00,0x00,0x00,0x00,0x00,0x00,0x00},
		//{0x30,0x28,0x3E,0x28,0x30,0x01,0x00,0x00,0x00,0x00,0x00,0x00,0x00,0x10,0x00,0x70,0x00,0xF0,0x00,0x00,0x00,0x00,0x00,0x00},
		//{0x30,0x28,0x3E,0x28,0x30,0x01,0x00,0x07,0x00,0x00,0x00,0x00,0x00,0x10,0x00,0x70,0x00,0xF0,0x00,0xF0,0x00,0x00,0x00,0x00},
		//{0x30,0x28,0x3E,0x28,0x30,0x01,0x00,0x07,0x00,0x1F,0x00,0x00,0x00,0x10,0x00,0x70,0x00,0xF0,0x00,0xF0,0x00,0xF0,0x00,0x00}

		{0x06,0x0A,0x3E,0x0A,0x06,0x00,0x00,0x00,0x00,0x00,0x00,0x00,0x00,0x02,0x00,0x00,0x00,0x00,0x00,0x00,0x00,0x00,0x00,0x00},
		{0x06,0x0A,0x3E,0x8A,0x06,0x00,0x00,0x00,0x00,0x00,0x00,0x00,0x00,0x02,0x00,0x03,0x00,0x00,0x00,0x00,0x00,0x00,0x00,0x00},
		{0x06,0x0A,0x3E,0x8A,0x06,0xE0,0x00,0x00,0x00,0x00,0x00,0x00,0x00,0x02,0x00,0x03,0x00,0x03,0x00,0x00,0x00,0x00,0x00,0x00},
		{0x06,0x0A,0x3E,0x8A,0x06,0xE0,0x00,0xF0,0x00,0x00,0x00,0x00,0x00,0x02,0x00,0x03,0x00,0x03,0x00,0x03,0x00,0x00,0x00,0x00},
		{0x06,0x0A,0x3E,0x8A,0x06,0xE0,0x00,0xF0,0x00,0xFC,0x00,0x00,0x00,0x02,0x00,0x03,0x00,0x03,0x00,0x03,0x00,0x03,0x00,0x00},
		{0x06,0x0A,0x3E,0x8A,0x06,0xE0,0x00,0xF0,0x00,0xFC,0x00,0xFF,0x00,0x02,0x00,0x03,0x00,0x03,0x00,0x03,0x00,0x03,0x00,0x03}
	};

	if(temp>32)
	{
		temp=0;
	}
	else
	{
		temp/=5;
		if(temp>5)temp=5;
	}

	draw_pic(pstr[temp],0,0,12,12);
}
#if 0
const unsigned char logo[]=
{
	/*------------------------------------------------------------------------------
	;  若数据乱码，请检查字模格式设置，注意选择正确的取模方向和字节位顺序。
	;  源文件 / 文字 : KMY
	;  宽×高（像素）: 52×18
	;  字模格式/大小 : 单色点阵液晶字模，纵向取模，字节倒序/156字节
	;  数据转换日期  : 2011-10-14 14:20:12
	------------------------------------------------------------------------------*/
	0xFF,0xFF,0xFF,0xFF,0xFF,0xFF,0xFF,0xFD,0x01,0x01,0x01,0x7D,0x3F,0x0D,0xC5,0xF1,
	0xF9,0xFD,0xFD,0xFF,0xFD,0x01,0x01,0x01,0x01,0x1F,0xFF,0x1F,0x01,0x01,0x01,0x01,
	0xFD,0xFD,0xF9,0xE1,0x81,0x01,0x1D,0x7F,0x7F,0x0D,0x81,0xF1,0xF9,0xFD,0xFF,0xFF,
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	0x02,0x02,0x02,0x03,0x03,0x03,0x03,0x03,0x03,0x03,0x03,0x03,
};
#else
static const unsigned char logo[]=
{
	//kmy原来的待机界面logo
	/*------------------------------------------------------------------------------
	;  若数据乱码，请检查字模格式设置，注意选择正确的取模方向和字节位顺序。
	;  源文件 / 文字 : C:\Documents and Settings\Administrator\桌面\logo.bmp字模
	;  宽×高（像素）: 52×18
	;  字模格式/大小 : 单色点阵液晶字模，纵向取模，字节倒序/156字节
	;  数据转换日期  : 2009-12-16 下午 03:01:27
	------------------------------------------------------------------------------*/
	0xff,0x53,0x53,0x53,0x57,0x7f,0x7f,0x5f,0x5f,0x57,0xd3,0xf3,0xf3,0xfb,0xff,0xff,
	0xff,0xff,0x53,0x53,0x53,0xd3,0x53,0x5f,0x7f,0xff,0xff,0x5f,0x53,0xd3,0x53,0x53,
	0x53,0xff,0xff,0xff,0xff,0xf3,0xf3,0xd3,0x53,0x5f,0x7f,0x7f,0x7f,0x5f,0x57,0xd3,
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	0x03,0x03,0x03,0x03,0x03,0x03,0x03,0x03,0x03,0x03,0x03,0x03,
};
#endif

 static const unsigned char adlogo[]=
 {
 0x00, 0x00, 0x00, 0x00, 0x00, 0x00, 0x00, 0x00, 0x00, 0x00, 0x00, 0x00, 0x00, 0x00, 0x00, 0x00,
0x00, 0x00, 0x00, 0x00, 0x00, 0x00, 0x00, 0x00, 0x00, 0x00, 0x00, 0x00, 0x00, 0x00, 0x00, 0x00,
0x00, 0x00, 0x00, 0x00, 0x00, 0x00, 0x00, 0x00, 0x00, 0x00, 0x00, 0x00, 0x00, 0x00, 0x00, 0x00,
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0x00, 0x00, 0x00, 0x00, 0x00, 0x00, 0x00, 0x00, 0x00, 0x00, 0x00, 0x00, 0x00, 0x00, 0x00, 0x00
};



void UpgradeSignalQuality(void)
{
	unsigned char Buf[100];
	char *p;
	unsigned char retval;
	
	static int SignalQuality;

	strcpy((char*)Buf,"AT+CSQ\r");	
	retval=send_at_cmd_and_receive(Buf,sizeof(Buf)-3,100,"OK");
	if(retval==TCP_OK)
	{
		p=strstr((char *)Buf,"+CSQ: ");
		if(p!=NULL)
		{
			SignalQuality=atoi(p+sizeof("+CSQ: ")-1);
			DisplaySignalQuality(SignalQuality);
		}
	}
}

void UpgradeWiFiSignal(void)
{
	unsigned char Buf[1500];
	unsigned char Signal[4];
	char *p;

	static unsigned char WiFi_Signal;
	
	if(GetSignalflag)
	{
		GetSignalflag=0;
		kmy_WiFi_USARTReceiveReset();
		kmy_WiFi_USARTSendString("sisrvy\r");
	}
	else
	{
	    GetSignalflag=1;
		kmy_WiFi_USARTReadToEnd((char *)Buf,sizeof(Buf));
		if(strstr((char *)Buf,"SECURITY")==NULL)return;
		
		if(strlen((char *)WLANSSID)==0)return;
		p = strstr((char *)Buf,(char *)WLANSSID);
		if(p != NULL)
		{
			if(strstr(p,"\r\n\r"))
			{
				p += 42;	
				memcpy(Signal,p,2);
				p = (char *)Signal;
				my_TwoAscciiToOneHex((unsigned char**)&p,&WiFi_Signal);
				printf("WiFi_Signal = %d\r\n",WiFi_Signal);
				DisplayWiFiSignal(WiFi_Signal);
			}
		}
		else 
		{
		    WiFi_Signal=0;
			printf("No WiFi_Signal\r\n");
			DisplayWiFiSignal(WiFi_Signal);
		}
	}		
}

void GetWiFiStatus(void)
{
	unsigned char cmdbuf[100]={0};
//	if(GetSignalflag==1)
//	{
	    Set_wifi_connstatus(cmdbuf,NULL_CHAR);	
		
		if(strstr((char*)cmdbuf,"CONNECTED"))
    	{
    	    clear_area_to_row(4,5);
    		DrawTitle_to_row_Language2 (4, "连接", "CONNECTED");
    	}
    	else
    	{
			kmy_WiFi_USARTSendString("connstatus 1\r");
			clear_area_to_row(4,5);
    		DrawTitle_to_row_Language2 (4, "未连接", "DISCONNECTED");
    	}
//	}
}


static void DisplayChargeElectricity(void)
{
	static unsigned char cnt;

	cnt++;
	if(cnt>4)cnt=0;

	draw_pic(pstr[cnt],116,0,12,12);
}

static u8 chargeflag;

void UpgradeElectricity(void)
{
	char HaveAcPowerFlag=0;
	static uint16_t Electricity;
	static unsigned char AcNewIn=1;

	Electricity= kmyGetVoltage(); 	

	HaveAcPowerFlag=kmy_BatGetACStatus();	
	
	if(HaveAcPowerFlag==AcStatus_Plug)	
	{
		if(Electricity<8280)
		{			
			if(Electricity>1200)
			{
			    
				if(kmy_BatGetChargeStatus()==ChargeStatus_Charge)
				{
					chargeflag=1;
				}
			}
			else
			{
				chargeflag=0;
				clear_area(116,0,12,12);
			}
			
		}
		else
		{
		
			if(Electricity>=8340&&AcNewIn==1)//&&(kmy_BatGetChargeStatus()==ChargeStatus_Charge))
			{
				AcNewIn=0;
				clear_lcd();
				DrawTitle_to_row_Language2(2,"电池电量已充满","Electricity Full");
				WaitkeyAndAutoExit(2000);
				InitFlag = 1;				
			}
			DisplayElectricity(Electricity);
			chargeflag=0;
		}
	}
	else
	{	
		if(Electricity>6700)
		{			
			DisplayElectricity(Electricity);  
		}
		else                   
		{	
		    DisplayPleaseCharge();          
			DisplayElectricity(Electricity);  
		}
		AcNewIn=1;
		chargeflag=0;
	}
}


void UpgradeCSPN(void)
{
	unsigned char Buf[100];
	unsigned char retval;
	char *p;
	const unsigned char *p2;

	strcpy((char*)Buf,"AT+COPS?\r");
	retval=send_at_cmd_and_receive(Buf,sizeof(Buf)-3,100,"OK");
	if(retval==TCP_OK)
	{
		p=strstr((const char *)Buf,"COPS");
		if(p!=NULL){
			p=strstr((const char *)p,"\"");
			if(p!=NULL)
			{
				p++;
				my_strcpy_EncounterHexEnd(Buf,(unsigned char*)p,16,'\"');
			}
			else
			{
				strcpy((char *)Buf,"Searching net");
			}
		}
		else
		{
			strcpy((char *)Buf,"Searching net");
		}

		clear_area(20,0,84,12);
		p2=GetNetName(Buf);
		DrawTitle_to_row_Language2(0,p2,Buf);
	}
}


static char ProcStandbyKey(char *msg)
{
	unsigned char keyval;
	unsigned char Buf[100];
	unsigned long cnt;
	static unsigned long PrevSeconds;
	static unsigned char powerdowntimecnt=0;
	
	if(InitFlag)
	{		
		InitFlag = 0;	
		clear_lcd();
		PrevSeconds=kmy_TimeGetRtcSeconds();		
		DisplayHourMinuteSecond(PrevSeconds);
		DisplayYearMothDayWeek(PrevSeconds);
		
		UpgradeElectricity();	
		if(chargeflag)DisplayChargeElectricity();	 
		
		draw_pic(logo,74,20,52,18);
		strcpy((char *)Buf,"Ver:");
		strcat((char *)Buf,(char *)(&softwareversion[4]));
		text_out(77,38,Buf);

		if(NetworkSwitch[0]==WiFi)
		{
			GetWiFiStatus();
    		//UpgradeWiFiSignal();	//更新WiFi信号量
			if(strlen((char*)WLANSSID)==0)DrawTitle_to_row(0,"No WiFi Connect");
			else DrawTitle_to_row(0,WLANSSID);
		}
		else
		{
			UpgradeSignalQuality();	//更新信号质量
			UpgradeCSPN();			//显示中国移动或中国联通			
			DrawTitle_to_row_Language2 (4, "Wireless terminal", "Wireless terminal");
		}
		powerdowntimecnt=0;
	}
	else
	{
		cnt=kmy_TimeGetRtcSeconds();		
		if(PrevSeconds!=cnt)
		{
			PrevSeconds=cnt;
			DisplayHourMinuteSecond(PrevSeconds);
			DisplayYearMothDayWeek(PrevSeconds);
			UpgradeElectricity();
			if(chargeflag)DisplayChargeElectricity();

			cnt=PrevSeconds%3;
			if(cnt==0)
			{
				if(NetworkSwitch[0]==WiFi)
				{
					//UpgradeWiFiSignal();	//更新WiFi信号量
					if(strlen((char*)WLANSSID)==0)DrawTitle_to_row(0,"No WiFi Connect");
					else DrawTitle_to_row(0,WLANSSID);
				}
        		else
        		{
        			UpgradeSignalQuality();	//更新信号质量
        			UpgradeCSPN();			//显示中国移动或中国联通
        		}		
			}
			else if(cnt==1)
			{	
				if(NetworkSwitch[0]==WiFi)
				{
					GetWiFiStatus();
			    }
			}
			else if(cnt==2)
			{
			}

			powerdowntimecnt++;
			if(powerdowntimecnt>30)gEnterPowerDownFlag=1; 

		}
	}

	keyval=GetKeyValue();
	if(keyval == KEY_NONE||keyval == KEY_WaitTimeout)return KEY_NONE;


	powerdowntimecnt=0;
	kmy_LcdBlackLightOn();			
	kmy_AutoOffLcdLight(10);		
	kmy_AutoPostKey(10);			
	StandbyResponseUserMenu(keyval);   

	return KEY_NONE;
}

//-----------------------Print LOGO--------------------
static char Printlogo(char *msg)
{
	unsigned char keyval;
	unsigned char Buf[100];
	unsigned long cnt;
	static unsigned long PrevSeconds;
	static unsigned char powerdowntimecnt=0;
	
	if(InitFlag)
	{		
		InitFlag = 0;	
		clear_lcd();
		 
		
		//draw_pic(logo,74,20,52,18);
		draw_pic(adlogo,0,0,128,64);
	}

	keyval=GetKeyValue();
	if(keyval == KEY_NONE||keyval == KEY_WaitTimeout)return KEY_NONE;


	powerdowntimecnt=0;
	kmy_LcdBlackLightOn();			
	kmy_AutoOffLcdLight(10);		
	kmy_AutoPostKey(10);			
	StandbyResponseUserMenu(keyval);   

	return KEY_NONE;
}


//-----------------------Print LOGO------------------------

unsigned char ApplicationInit(void)
{
	u8 retval;
	
	kmy_RCCInit();
	
	kmy_TimeInit();

	kmy_VCC3V5V_Init();
	kmy_BeepInit();
	kmy_BeepOff(); 

	kmy_USART1Init(115200);	

	kmy_LcdInit();
	kmy_LcdBlackLightOn();
	kmy_LcdClear();
//	kmy_LcdDrawBitMap(PoweronLogo,0,0,128,64);
	DrawTitle_to_row(2,"System booting...");	 

	kmy_FlashInit();

	kmy_KeyInit();

	kmy_BeepInit();

	kmy_EepromInit();

	if(kmy_EepromCheckWhetherBlankChip()==1)
	{
		EepromFile_FileSystemFormat();
	}

	kmy_MagcardInit();

	kmy_MiscInit();

	kmy_BatInit();
			
	kmy_psamInit();
	
	kmy_RFInit();

	kmyAdcInit();
	
	kmy_PrinterInit(0);
	
	retval=EepromFile_CheckFileExist(efile_Config);
	if(retval==EepromFile_FileNameToLong)
	{
		clear_lcd();
		DrawTitle_to_row_Language2(2,"配置文件名太长","FileName too long");
	}
	else if(retval==EepromFile_HaveThisFile)
	{
		retval=RestoreGlobalVariable();
		if(retval!=1)
		{
			clear_lcd();
			DrawTitle_to_row_Language2(2,"恢复全局变量失败","Restore Variable Fail");

			EepromFile_FileSystemFormat();
			RestoreConfigFile();
			WaitkeyAndAutoExit (2);
			NVIC_SystemReset();			
		}
	}
	else if(retval==EepromFile_HaveNotThisFile)
	{
	    EepromFile_FileSystemFormat();
		retval=RestoreConfigFile();
		if(retval!=1)
		{
			clear_lcd();
			DrawTitle_to_row_Language2(2,"恢复配置文件失败","Restore File Fail");
			WaitkeyAndAutoExit(2);
			NVIC_SystemReset();
		}
	}
	
    if(NetworkSwitch[0]==WiFi)
    {
    //	kmy_WifiInit();
		printf("WiFi Mode\r\n");
    }
	else
	{
		kmy_GprsInit();
		msleep(1000);
		Sim900B_init();	
		printf("GPRS Mode\r\n");
	}

	set_contrast(atoi((const char *)LightPercent));
	kmy_BackUpInit();

	return 1;
}



void DestroyFunc(void)
{
	unsigned char secretkey[6]={0}; 	
	unsigned char temp;
	unsigned char count=0;
	unsigned int retval;

	clear_lcd();
	DrawTitle_to_row_Language2(2,"非法拆机","Illegal open");
	DrawTitle_to_row_Language2(3,"芯片已自毁","Chip destroied");

	while(1)
	{
		retval=kmy_GetKeyValue();
		if(retval==KEY_NONE)continue;
		BeepNormal();
		switch(retval)
		{
			case KEY1 : temp='1';printf("key is 1 \r\n");break;
			case KEY2 : temp='2';printf("key is 2 \r\n");break;
			case KEY3 : temp='3';printf("key is 3 \r\n");break;
			case KEY4 : temp='4';printf("key is 4 \r\n");break;
			case KEY5 : temp='5';printf("key is 5 \r\n");break;
			case KEY6 : temp='6';printf("key is 6 \r\n");break;
			case KEY7 : temp='7';printf("key is 7 \r\n");break;
			case KEY8 : temp='8';printf("key is 8 \r\n");break;
			case KEY9 : temp='9';printf("key is 9 \r\n");break;
			case KEY0 : temp='0';printf("key is 0 \r\n");break;
			case KEYJING :
			temp='#';printf("key is JING \r\n");
			break;
			case KEYXING :
			memset(secretkey,0,sizeof(secretkey));
			count=0;
			printf("key is XING \r\n");
			continue;
			default: break;
		}

		if(count<sizeof(secretkey)-1)
		{
			secretkey[count]=temp;
			count++;
			if(strcmp((const char *)secretkey,"#123#")==0)
			{
				kmy_ClearTamper();
				printf("unlock!!!\r\n");
				return;
			}
		}
		else
		{
			memset(secretkey,0,sizeof(secretkey));
			count=0;
		}
	}
}



#if 1

int main(void)
{
	ApplicationInit();
	kmy_LcdBlackLightOn();
	kmy_AutoOffLcdLight(20);

//	CurProc=ProcStandbyKey;	 
	CurProc=Printlogo;
	frontend();
 /*      ------------- working----------------
	while(1)
	{
		CurProc(NULL);

	/*
		if(kmy_CheckTamper()==TAMPER_TRIGGERED)
		{
			DestroyFunc();
			InitFlag=1;
		} 
  	*/
  	  /*--------------working----------------------------  
		if(gEnterPowerDownFlag==1&&Model[0]=='1')		
		{
		    if(NetworkSwitch[0]==WiFi)
            {
				kmy_WiFiOnOff (0);
				printf("\n WiFiOFF");
            }
			kmy_EnterPowerDownMode();
			gEnterPowerDownFlag=0;
			InitFlag=1;
			KMY_WakeUpGPIOInit();
			if(NetworkSwitch[0]==WiFi)
            {
                kmy_LcdBlackLightOn();	
				DrawTitle_to_row(2,"Initial WiFi");
				DrawTitle_to_row(3,"Please wait...");
            	kmy_WifiInit();
            }
						
			set_contrast(atoi((const char *)LightPercent));
		}  --------------------------working-----------------------			

	}  */
	

}
#endif
